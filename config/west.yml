## config/west.yml
```yaml
manifest:
  remotes:
    - name: zmkfirmware
      url-base: https://github.com/zmkfirmware
    - name: kot149
      url-base: https://github.com/kot149
  projects:
    - name: zmk
      remote: zmkfirmware
      revision: main
      import: app/west.yml

    # https://github.com/kot149/prospector-scanner-zmk-module
    - name: prospector-scanner-zmk-module
      remote: kot149
      revision: main
      path: modules/prospector-scanner-zmk-module-kot149
  self:
    path: config
```
